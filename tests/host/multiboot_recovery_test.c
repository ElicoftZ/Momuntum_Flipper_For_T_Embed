/* Compile with recovery.c and layout.c using the stubs generated by
 * run_multiboot_tests.py. The verifier accepts only the two complete fixture
 * tables; production uses ESP-IDF's MD5 verifier. */
#include "layout.h"
#include <assert.h>
#include <setjmp.h>
#include <stdio.h>
#include <string.h>

static unsigned char flash[0x14000], old_table[MB_SECTOR_SIZE], new_table[MB_SECTOR_SIZE];
static jmp_buf power_loss;
static int mutation, interrupt_at;
static size_t cut;
void bootloader_after_init(void);

int esp_partition_table_verify(const void* p, bool log, int* count) {
    (void)log;
    if(!memcmp(p, old_table, MB_SECTOR_SIZE)) { *count = MB_SYSTEM_COUNT; return 0; }
    if(!memcmp(p, new_table, MB_SECTOR_SIZE)) { *count = MB_SYSTEM_COUNT + 1; return 0; }
    return -1;
}
int bootloader_flash_read(size_t at, void* out, size_t n, bool decrypt) {
    (void)decrypt; assert(at + n <= sizeof(flash)); memcpy(out, flash + at, n); return 0;
}
int bootloader_flash_write(size_t at, const void* data, size_t n, bool encrypt) {
    (void)encrypt; assert(at + n <= sizeof(flash));
    if(++mutation == interrupt_at) { memcpy(flash + at, data, cut); longjmp(power_loss, 1); }
    memcpy(flash + at, data, n); return 0;
}
int bootloader_flash_erase_sector(size_t sector) {
    size_t at = sector * MB_SECTOR_SIZE; assert(at + MB_SECTOR_SIZE <= sizeof(flash));
    if(++mutation == interrupt_at) { memset(flash + at, 0xff, cut); longjmp(power_loss, 1); }
    memset(flash + at, 0xff, MB_SECTOR_SIZE); return 0;
}
int main(int argc, char** argv) {
    assert(argc == 2);
    FILE* f = fopen(argv[1], "rb"); assert(f);
    memset(old_table, 0xff, sizeof(old_table));
    assert(fread(old_table, 1, 3072, f) == 3072); fclose(f);
    memcpy(new_table, old_table, sizeof(new_table));
    size_t count = MB_SYSTEM_COUNT; MbEntry added;
    assert(mb_layout_add((MbEntry*)new_table, &count, 3000000, &added));
    memset(new_table + count * sizeof(MbEntry), 0xff, sizeof(new_table) - count * sizeof(MbEntry));
    unsigned cases = 0;
    for(int step = 1; step <= 5; ++step) {
        for(size_t bytes = 0; bytes <= MB_SECTOR_SIZE; bytes += 32) {
            memset(flash, 0xff, sizeof(flash));
            memcpy(flash + MB_TABLE_ADDRESS, old_table, sizeof(old_table));
            memcpy(flash + MB_PENDING_ADDRESS, new_table, sizeof(new_table));
            mutation = 0; interrupt_at = step; cut = bytes;
            if(!setjmp(power_loss)) bootloader_after_init();
            interrupt_at = 0; bootloader_after_init();
            assert(!memcmp(flash + MB_TABLE_ADDRESS, new_table, sizeof(new_table)));
            int pending_count;
            /* Interrupted cleanup may leave an invalid partial sector, which
             * is safely ignored and erased before the next transaction. */
            assert(esp_partition_table_verify(flash + MB_PENDING_ADDRESS, false, &pending_count) != 0);
            bootloader_after_init();
            assert(!memcmp(flash + MB_TABLE_ADDRESS, new_table, sizeof(new_table)));
            ++cases;
        }
    }
    memset(flash, 0xff, sizeof(flash));
    memcpy(flash + MB_TABLE_ADDRESS, old_table, sizeof(old_table));
    memset(flash + MB_PENDING_ADDRESS, 0x55, MB_SECTOR_SIZE);
    bootloader_after_init();
    assert(!memcmp(flash + MB_TABLE_ADDRESS, old_table, sizeof(old_table)));
    memcpy(flash + MB_BACKUP_ADDRESS, old_table, sizeof(old_table));
    memset(flash + MB_TABLE_ADDRESS, 0, MB_SECTOR_SIZE);
    bootloader_after_init();
    assert(!memcmp(flash + MB_TABLE_ADDRESS, old_table, sizeof(old_table)));
    printf("PASS: %u interrupted flash mutations recover; invalid pending ignored; backup restores primary\n", cases);
    return 0;
}
